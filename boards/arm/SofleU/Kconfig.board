## boards/arm/SofleU/Kconfig.board
```kconfig
#
# Copyright (c) 2024 The ZMK Contributors
# SPDX-License-Identifier: MIT
#

config BOARD_SOFLEU_LEFT
    bool "SofleU left"
    depends on SOC_NRF52840_QIAA

config BOARD_SOFLEU_RIGHT
    bool "SofleU right"
    depends on SOC_NRF52840_QIAA
```
